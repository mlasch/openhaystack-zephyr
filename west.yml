## west.yml
```yaml
manifest:
  self:
    path: openhaystack-zephyr
  remotes:
    - name: zephyrproject-rtos
      url-base: https://github.com/mlasch
  projects:
    - name: zephyr
      remote: zephyrproject-rtos
      revision: 64e37f6b0e87cd9836cd5342d702c74df6540777
      import:
        name-allowlist:
          - cmsis_6
          - hal_espressif
          - hal_nordic
          - hal_stm32
          - mbedtls
          - mcuboot
          - mcumgr
          - segger
```
